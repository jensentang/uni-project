#include "oled.h"
#include <cstdarg>
#include <cstdio>
#include <cstring>

// Standard 5x7 ASCII Font Data
static const uint8_t font5x7[] = {
    0x00, 0x00, 0x00, 0x00, 0x00, // Space
    0x00, 0x00, 0x5F, 0x00, 0x00, // !
    0x00, 0x07, 0x00, 0x07, 0x00, // "
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    0x61, 0x51, 0x49, 0x45, 0x43  // Z
};

Adafruit_SSD1306_I2c::Adafruit_SSD1306_I2c(I2C &i2c, PinName rst, uint8_t i2cAddress, uint8_t rawHeight, uint8_t rawWidth)
    : _i2c(i2c), _addr(i2cAddress), _width(rawWidth), _height(rawHeight), _cursorX(0), _cursorY(0), _textSize(1) {
    memset(_buffer, 0, sizeof(_buffer));
}

void Adafruit_SSD1306_I2c::sendCommand(uint8_t c) {
    char buf[2] = {0x00, (char)c};
    _i2c.write(_addr, buf, 2);
}

void Adafruit_SSD1306_I2c::begin() {
    sendCommand(0xAE); // Display OFF
    sendCommand(0xD5); sendCommand(0x80); 
    sendCommand(0xA8); sendCommand(_height - 1); 
    sendCommand(0xD3); sendCommand(0x00); 
    sendCommand(0x40); // Start line 0
    sendCommand(0x8D); sendCommand(0x14); // Enable charge pump
    sendCommand(0x20); sendCommand(0x00); // Horizontal addressing mode
    sendCommand(0xA1); // Segment remap
    sendCommand(0xC8); // COM scan direction
    sendCommand(0xDA); sendCommand(_height == 64 ? 0x12 : 0x02);
    sendCommand(0x81); sendCommand(0xCF); 
    sendCommand(0xD9); sendCommand(0xF1); 
    sendCommand(0xDB); sendCommand(0x40); 
    sendCommand(0xA4); 
    sendCommand(0xA6); 
    sendCommand(0xAF); // Display ON
    clearDisplay();
}

void Adafruit_SSD1306_I2c::clearDisplay() {
    memset(_buffer, 0, sizeof(_buffer));
    _cursorX = 0;
    _cursorY = 0;
}

void Adafruit_SSD1306_I2c::drawPixel(int16_t x, int16_t y, bool color) {
    if (x < 0 || x >= _width || y < 0 || y >= _height) return;
    if (color) {
        _buffer[x + (y / 8) * _width] |= (1 << (y & 7));
    } else {
        _buffer[x + (y / 8) * _width] &= ~(1 << (y & 7));
    }
}

void Adafruit_SSD1306_I2c::drawChar(int16_t x, int16_t y, unsigned char c, bool color, uint8_t size) {
    if (c < 32 || c > 90) c = ' '; // Convert unmapped characters to space
    int fontIndex = (c - 32) * 5;

    for (int8_t i = 0; i < 5; i++) {
        uint8_t line = font5x7[fontIndex + i];
        for (int8_t j = 0; j < 8; j++) {
            if (line & 0x01) {
                if (size == 1) {
                    drawPixel(x + i, y + j, color);
                } else {
                    for (uint8_t sx = 0; sx < size; sx++) {
                        for (uint8_t sy = 0; sy < size; sy++) {
                            drawPixel(x + (i * size) + sx, y + (j * size) + sy, color);
                        }
                    }
                }
            }
            line >>= 1;
        }
    }
}

void Adafruit_SSD1306_I2c::display() {
    sendCommand(0x21); sendCommand(0); sendCommand(127); // Column addr
    sendCommand(0x22); sendCommand(0); sendCommand(7);   // Page addr

    // Send buffer in 16-byte chunks to fit I2C FIFO constraints
    char sendBuf[17];
    sendBuf[0] = 0x40; // Data stream marker
    for (uint16_t i = 0; i < sizeof(_buffer); i += 16) {
        memcpy(&sendBuf[1], &_buffer[i], 16);
        _i2c.write(_addr, sendBuf, 17);
    }
}

void Adafruit_SSD1306_I2c::setTextCursor(int16_t x, int16_t y) {
    _cursorX = x;
    _cursorY = y;
}

void Adafruit_SSD1306_I2c::setTextSize(uint8_t size) {
    _textSize = (size > 0) ? size : 1;
}

void Adafruit_SSD1306_I2c::printf(const char *format, ...) {
    char buffer[128];
    va_list args;
    va_start(args, format);
    vsnprintf(buffer, sizeof(buffer), format, args);
    va_end(args);

    for (int i = 0; buffer[i] != '\0'; i++) {
        if (buffer[i] == '\n') {
            _cursorX = 0;
            _cursorY += _textSize * 8;
        } else {
            drawChar(_cursorX, _cursorY, buffer[i], true, _textSize);
            _cursorX += _textSize * 6;
            if (_cursorX > (_width - (_textSize * 6))) {
                _cursorX = 0;
                _cursorY += _textSize * 8;
            }
        }
    }
}